#include <stdio.h>
#include <stdlib.h>
#include <string.h>
#include <bls_BLS12381.h>
#include <pair_BLS12381.h>
#include "esp_system.h"
#include "esp_random.h"
#include <randapi.h>
#include <WiFi.h>
#include "esp_wifi.h"
#include "mbedtls/aes.h"
#include "Schnorr.h"

using namespace core;
using namespace BLS12381;
//using namespace BLS12381_FP;
using namespace BLS12381_BIG;

//Schnorr related variables
unsigned char mynonce[NONCE_SIZE] = {0};
unsigned char digest[SHA256_DIGEST_LENGTH];
unsigned char public_point[64];
Schnorr schnorr;

SET_LOOP_TASK_STACK_SIZE(17*1024);
unsigned long start()
{
    unsigned long start_time=micros();
    return start_time;
}

void stop(unsigned long start_time)
{
    unsigned long end_time=micros();
    Serial.print(end_time-start_time);
//    Serial.println(" microseconds");
}



const int arraySize = 1;
int rows[arraySize][arraySize] = {
    {1}
};

char policy[] = {"Gov"};
char attributes[arraySize][5] = {"Gov"};
char GTchar[MODBYTES_B384_29  * 12];
octet GTOctet = {0,MODBYTES_B384_29  * 12,GTchar};  
int policy_len = 87;
int totalLength = 62+770+arraySize*49+policy_len+5+64;
char combinedCharArray[62+770+arraySize*49+87+5+64];

      
csprng RNG;                // Crypto Strong RNG
//FABEO related materials
BIG r,s0,s1,mys0;
BIG v[arraySize];
ECP bHash,attr_Hash[arraySize],ct[arraySize],myg1;
ECP2 pkh,myg2,g_s0,h_s1;
FP12 rnonce, eghAlpha,Cp;

//drone related data
char drone_uid[] = {0xde, 0xad, 0xfe, 0xed}; 
char drone_data[] = {0x0A,0x00,0x01,0x00,0x07,0xE5,0x07,0xE5,0x14,0x00,0x0A,0x00,0x01,0x00,0x07,0xE5,0x07,0xE5,0x14,0x00};
uint8_t GCS_data[] = {0xAB,0XCD,0XEF,0XFE,0XED,0XDE,0XAD,0XBA,0XDD,0XAD,0XBE,0XEF,0XDD,0XAD,0XBE,0XEF};

//wifi packet header
const uint8_t header[] = { 
// Data frame header
  0x08, 0x02,       // Frame Control
  0x00, 0x00,       // Duration
  0xFF, 0xFF, 0xFF, 0xFF, 0xFF, 0xFF, // Destination MAC
  0x12, 0x34, 0x56, 0x78, 0x9A, 0xBC, // Source MAC
  0xDE, 0xAD, 0xBE, 0xEF, 0xFE, 0xED };


/*
 * intialize the public key's G2 point
 */

void init_pkh() {
    // The coordinates
//char xcoord1[] ={0x14, 0x6b, 0xe3, 0xca, 0x42, 0xfd, 0xcd, 0xa1, 0x09, 0x14, 0x62, 0x73, 0x98, 0x96, 0x3b, 0x9c, 0x24, 0xb7, 0x83, 0xea, 0x5c, 0x82, 0x80, 0xee, 0xb0, 0xa4, 0x22, 0xcf, 0x13, 0xa4, 0x2c, 0x79};
//char xcoord2[] ={0x1c, 0x9c, 0xaa, 0x91, 0xdc, 0xba, 0xe8, 0x09, 0x7f, 0x95, 0xa2, 0xc2, 0xb0, 0x8f, 0xe5, 0xdf, 0x1a, 0x81, 0xd1, 0x21, 0x91, 0x63, 0x5c, 0x4b, 0x98, 0x45, 0x47, 0xc6, 0xfb, 0x08, 0xd7, 0x38};
//char ycoord1[] ={0x09, 0xa3, 0x70, 0x4a, 0x8f, 0xb2, 0xaf, 0xd4, 0xef, 0x1d, 0x71, 0xbf, 0x87, 0x75, 0x5a, 0xba, 0xc5, 0x43, 0x87, 0xda, 0x9b, 0x62, 0x9d, 0x44, 0x9a, 0x68, 0xec, 0x19, 0x3f, 0x0f, 0x13, 0x84};
//char ycoord2[] ={0x02, 0xb2, 0xf4, 0x97, 0x24, 0x2f, 0xa3, 0xf5, 0x27, 0x58, 0x45, 0xb9, 0x27, 0xfe, 0xe9, 0x51, 0x1b, 0xca, 0x7a, 0x0e, 0x76, 0x6c, 0x3f, 0x32, 0x17, 0x5a, 0x68, 0x2d, 0x43, 0x34, 0x26, 0x3e};
//
//    // Init the coordinates
//    BIG ax, bx, ay, by;
//    BIG_fromBytes(ax,xcoord1);
//    BIG_fromBytes(bx,xcoord2);
//    BIG_fromBytes(ay,ycoord1);
//    BIG_fromBytes(by,ycoord2);
//
//    // Create the FP2 coordinates
//    FP2 x, y;
//    FP2_from_BIGs(&x, ax, bx);
//    FP2_from_BIGs(&y, ay, by);
//    ECP2_set(&pkh, &x,&y);

BIG_randomnum(mys0, r, &RNG);
ECP2_generator(&pkh);
PAIR_G2mul(&pkh, mys0);
//ECP2_copy(&pkh,&myg2);

    (PAIR_G2member(&pkh)==1)? Serial.println("pkh on G2"): Serial.println("pkh not on G2");

}


/*
 * intialize the public key's GT point
 */
void init_eghAlpha(){
//  char values[3][2][2][32]={
// { //A
//  {{0x1E, 0x00, 0xE2, 0xC8, 0x62, 0x46, 0x20, 0x08, 0xC6, 0xFC, 0x2B, 0x2A, 0xF9, 0xB3, 0xC2, 0x7F, 0x66, 0x2C, 0x7F, 0x37, 0xC7, 0x11, 0x08, 0x83, 0xE5, 0xD3, 0x0A, 0x3F, 0x9A, 0x91, 0x73, 0xA3}, 
//  {0x1F, 0x82, 0x8B, 0x43, 0xF7, 0xAC, 0x31, 0x08, 0x48, 0x1F, 0x86, 0x46, 0xB8, 0xF4, 0x44, 0x11, 0xC9, 0xB5, 0x0A, 0xDB, 0x15, 0x99, 0xB5, 0x95, 0x37, 0x5D, 0xE6, 0x20, 0x93, 0x79, 0x21, 0x5D}}, 
//  {{0x09, 0x9A, 0x3A, 0x64, 0xC4, 0x1D, 0x61, 0xF2, 0x0E, 0x1A, 0xAF, 0x08, 0x0F, 0x6E, 0x24, 0xC6, 0xAF, 0xEA, 0xA5, 0x82, 0x93, 0xA6, 0xD9, 0xFE, 0x31, 0x12, 0xE3, 0x1B, 0xC6, 0x09, 0x85, 0xFD}, 
//  {0x09, 0x6B, 0x12, 0x6B, 0xF8, 0x65, 0x1F, 0xB8, 0x5C, 0x95, 0xBB, 0xF0, 0x2E, 0xA5, 0xD5, 0xD3, 0x9C, 0x63, 0x36, 0x23, 0x2E, 0x7E, 0xEB, 0x81, 0x80, 0x03, 0x1D, 0xAC, 0xC9, 0xFB, 0x3E, 0x56}}
//  }, 
//  {//B
//  {{0x0D, 0xF8, 0xEF, 0x08, 0x6D, 0xF2, 0x11, 0x26, 0x78, 0xC0, 0x1B, 0xBC, 0x92, 0x2E, 0xBE, 0x34, 0xB1, 0xC3, 0xA7, 0x7B, 0xCC, 0xB1, 0x9D, 0xB7, 0xA7, 0x60, 0x16, 0x2F, 0x2B, 0x88, 0xCD, 0x76}, 
//  {0x1E, 0x93, 0xF4, 0x61, 0x28, 0x33, 0xE4, 0x86, 0x17, 0x04, 0x22, 0xEE, 0x59, 0x27, 0xDF, 0x17, 0x4E, 0x68, 0x16, 0xFB, 0x65, 0xAE, 0x54, 0xC6, 0x07, 0x7B, 0xA2, 0x31, 0xF7, 0x29, 0xD3, 0x5F}}, 
//  {{0x11, 0x8A, 0xE2, 0x1F, 0xD7, 0x70, 0xD7, 0x36, 0x26, 0x51, 0x55, 0x69, 0x33, 0x5D, 0xFD, 0xF5, 0x9E, 0xED, 0xB0, 0xC1, 0xB7, 0xD7, 0x50, 0x90, 0x90, 0x8B, 0xC4, 0xF0, 0xD4, 0x22, 0x45, 0xE3}, 
//  {0x24, 0x61, 0x34, 0xFC, 0x95, 0x14, 0x87, 0x18, 0x71, 0x41, 0xBA, 0x17, 0x94, 0x5B, 0xB9, 0x90, 0x3A, 0x4D, 0x7E, 0xEA, 0x15, 0x11, 0x7C, 0x83, 0x56, 0x7E, 0x25, 0xEA, 0x55, 0xCD, 0xE9, 0xB3}}
//  }, 
//  {//C  
//  {{0x0B, 0x3B, 0x72, 0x3E, 0x7D, 0x15, 0x71, 0x26, 0x1B, 0xBC, 0x93, 0x09, 0x38, 0x0C, 0xDB, 0x3C, 0xE1, 0x8D, 0x18, 0x71, 0x0A, 0xDF, 0x54, 0xDC, 0xE7, 0x0C, 0x46, 0x51, 0x33, 0x68, 0x93, 0x81}, 
//  {0x16, 0xCC, 0xC0, 0x1D, 0x16, 0x96, 0x0B, 0x3F, 0xD5, 0xC3, 0x4E, 0xE0, 0xAB, 0x6D, 0x4D, 0xB6, 0xF7, 0xA0, 0x7C, 0x9C, 0x09, 0xCB, 0x82, 0x55, 0x23, 0xD5, 0x4D, 0x2B, 0x26, 0x2E, 0xA0, 0xEE}}, 
//  {{0x15, 0xD2, 0x4E, 0x58, 0xE7, 0x0B, 0xDE, 0x81, 0x69, 0x04, 0xA1, 0x03, 0xD2, 0xDA, 0xCB, 0x87, 0xB5, 0x31, 0xF1, 0xCD, 0x7D, 0x54, 0x52, 0x3D, 0x5D, 0x3D, 0xFC, 0x69, 0x07, 0x98, 0xBC, 0xC7}, 
//  {0x0B, 0x5A, 0x56, 0xF1, 0x78, 0x36, 0x06, 0xB9, 0x17, 0x0F, 0x69, 0x5A, 0x5A, 0x61, 0xB1, 0x09, 0xAB, 0x17, 0xFD, 0x8A, 0xE6, 0x6A, 0x2E, 0xC0, 0x46, 0x0A, 0x42, 0x5A, 0xE1, 0x2B, 0x77, 0x6C}}
//  }
//};
//  FP4 fp4s[3];
//
//  for(int i=0;i<3;i++){
//    FP2 fp2s[2];
//    for(int j=0;j<2;j++){
//      BIG v1,v2;
//      BIG_fromBytes(v1,values[i][j][0]);
//      BIG_fromBytes(v2,values[i][j][1]);
//      FP2_from_BIGs(&fp2s[j],v1,v2);
//    }
//    FP4_from_FP2s(&fp4s[i],&fp2s[0],&fp2s[1]);
//  }
//  FP12_from_FP4s(&eghAlpha,&fp4s[0],&fp4s[1],&fp4s[2]);
//FP12 myeghAlpha;

BIG_randomnum(mys0, r, &RNG);
ECP_generator(&myg1);
ECP2_generator(&myg2);
PAIR_G1mul(&myg1, mys0);
PAIR_G2mul(&myg2, mys0); 
PAIR_ate(&eghAlpha, &myg2, &myg1);
PAIR_fexp(&eghAlpha);

  (PAIR_GTmember(&eghAlpha)==1)? Serial.println("ëgh_alpha_init on GT"): Serial.println("ëgh_alpha_init not on GT");

}
/*
 * Get all the required cryptographic materials
 * pkh,pk_eghAlpha
 */

void get_keys(){
  //get all the cryptographic materials required for the reciever and initalize them (maybe from a file)
  char pkh_hex[MODBYTES_B384_29  * 2 +1]={0x03,0x10,0x5F,0x02,0x07,0x21,0x81,0x88,0x8A,0x12,0x3B,0x7F,0x19,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0x01,0x8E};
  octet pkh_octet={0,MODBYTES_B384_29  * 2 +1,pkh_hex};
  ECP2_fromOctet(&pkh,&pkh_octet);
    Serial.print("pkh:");ECP2_output(&pkh);Serial.println("");
    (PAIR_G2member(&pkh)==1)? Serial.println("pkh on G2"): Serial.println("pkh not on G2");

//  char eghAlpha_hex[MODBYTES_B384_29  * 12]={0x0B,0x5A,0x56,0xF1,0x78,0x36,0x06,0xB9,0x17,0x0F,0x69,0x5A,0x5A,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0x73,0xA3};
//  octet eghAlpha_octet = {0,MODBYTES_B384_29  * 12,eghAlpha_hex};
//    Serial.print("eghAlpha:");FP12_output(&eghAlpha);Serial.println("");   
//    (PAIR_GTmember(&eghAlpha)==1)? Serial.println("ëgh_alpha_init on GT"): Serial.println("ëgh_alpha_init not on GT");

  }




/*
 * compute hashes of the curve_order+1 and the attributes in the policy and map them to points on G1 
 */
void compute_hashes(){
  Serial.println(" ");
  Serial.print("time for hash");unsigned long start_time=start();
  BIG order;
  char orderChar[MODBYTES_B384_29];
  BIG_rcopy(order, CURVE_Order);
  BIG_inc(order,1);
  BIG_toBytes(orderChar, order);
  octet orderOctet = {strlen(orderChar), MODBYTES_B384_29, orderChar};
  Serial.println();Serial.print("orderOctet:");Serial.println(orderOctet.len);
  //compute bHash
  BLS_HASH_TO_POINT(&bHash, &orderOctet);Serial.println(""); 
  Serial.print("bHash:");ECP_output(&bHash);Serial.println("");
  OCT_output(&orderOctet);Serial.println("");
  
  //compute attr_Hash
  for (int i=0;i<arraySize;i++){
    octet attr = {strlen(attributes[i]), sizeof(attributes[i]), attributes[i]};
    BLS_HASH_TO_POINT(&attr_Hash[i], &attr); 
    Serial.print("attr_Hash[i]:");ECP_output(&attr_Hash[i]);Serial.println("");
      }
    stop(start_time);Serial.println("");
  
}
/*
 * Compute KDF from the G2 rnonce point
 */

void computeKDF(FP12* input, uint8_t* derivedKey)
{
    int keyLength = 16; // Desired key length in bytes
    char orderChar[MODBYTES_B384_29 * 12];
    octet outputOctet = {0, MODBYTES_B384_29 * 12, orderChar};

    FP12_toOctet(&outputOctet, input);
    octet keyOctet = {0, keyLength, (char*)derivedKey};
    octet* params = NULL;

    // Perform the KDF2 operation
    KDF2(MC_SHA2, SHA256, &keyOctet, keyLength, &outputOctet, params);
}

/*
 * Encrypt the input palintext with the given key using AES ECB mode and put it in the buffer
 */
void encrypt_ecb(uint8_t* plainText, uint8_t* key, uint8_t* outputBuffer) {
  mbedtls_aes_context aes;

  mbedtls_aes_init(&aes);
  mbedtls_aes_setkey_enc(&aes, key, 16 * 8);
  mbedtls_aes_crypt_ecb(&aes, MBEDTLS_AES_ENCRYPT, (const unsigned char*)plainText, outputBuffer);
  mbedtls_aes_free(&aes);
}



void setup() {
  int i;
  int current_pos =0;
  Serial.begin(115200);
    while (!Serial);
    WiFi.mode(WIFI_AP);
//     WiFi.softAP("LGqHDTV+", "dummbypassword", 1, 1, 4);
//WiFi.mode(WIFI_MODE_NULL);
    char raw[100];
    octet RAW = {0, sizeof(raw), raw};
    RAW.len = 100;
//    for (i = 0; i < 100; i++) RAW.val[i] = i + 1;
    esp_fill_random(raw, sizeof(raw));
    CREATE_CSPRNG(&RNG, &RAW);  // initialise strong RNG
    
    //copy headers and other drone data
memcpy(combinedCharArray+current_pos,header,22);
    current_pos += 22;
memcpy(combinedCharArray+current_pos,drone_uid,4);
    current_pos += 4;
memcpy(combinedCharArray+current_pos,drone_data,20);
    current_pos += 20;
   
   
BIG_rcopy(r, CURVE_Order);

////initalize pkh
init_pkh();
//
////initalize eghAlpha
init_eghAlpha();
//
////initialize cryptographic keys
//get_keys();
//
//// compute bHash and attrHash[]  
compute_hashes();


Serial.println("Starting loop");
delay(1000);
for(int a=0;a<10;a++){
  unsigned long total_time=start();
//Serial.print("rnonce comp time:");
unsigned long start_time=start();
// Generate random nonce

uint8_t rnonce_key[16];
uint8_t GCS_data_encrypted[16];

BIG_randomnum(s0, r, &RNG);
ECP_generator(&myg1);
ECP2_generator(&myg2);
ECP_mul(&myg1, s0);
ECP2_mul(&myg2, s0); 
PAIR_ate(&rnonce, &myg2, &myg1);
PAIR_fexp(&rnonce);
stop(start_time);Serial.print(",");
delay(1000);

//Serial.print("rnoncekey comp time:");
start_time=start();
computeKDF(&rnonce,rnonce_key);
encrypt_ecb(GCS_data,(uint8_t*)rnonce_key,(uint8_t*)GCS_data_encrypted);
current_pos = 46; 
memcpy(combinedCharArray+current_pos,GCS_data_encrypted,16);
    current_pos += 16; 
stop(start_time);Serial.print(",");
(PAIR_GTmember(&rnonce)==1)? Serial.println("rnonce on GT") : Serial.println("rnonce not on GT");



//generate s0,s1,v[]
Serial.print("s0,s1,v[] comp time:");
start_time=start();
BIG_randomnum(s0, r, &RNG);
//Serial.print("s0:");BIG_output(s0);Serial.println("");
BIG_randomnum(s1, r, &RNG);
//Serial.print("s1:");BIG_output(s1);Serial.println("");
BIG_rcopy(v[0],s0);
for (i=1;i<arraySize;i++){
  BIG_randomnum(v[i], r, &RNG);
}
stop(start_time);Serial.print(",");


//compute g_s0,h_s1

start_time=start();
ECP2_copy(&g_s0,&pkh);
ECP2_copy(&h_s1,&pkh);
PAIR_G2mul(&g_s0, s0);
PAIR_G2mul(&h_s1, s1); 
Serial.print("gs0,hs1 comp time:");stop(start_time);Serial.print(",");
//(PAIR_G2member(&g_s0)==1)? Serial.println("g_s0 on G2") : Serial.println("g_s0 not on G2");
//(PAIR_G2member(&h_s1)==1)? Serial.println("h_s1 on G2"): Serial.println("h_s1 not on G2");

//compute Cp

start_time=start();
FP12_pow(&Cp,&eghAlpha,s0);
//FP12_copy(&Cp,&eghAlpha);
//PAIR_GTpow(&Cp,s0);
FP12_mul(&Cp,&rnonce);
stop(start_time);Serial.print(",");
//(PAIR_GTmember(&Cp)==1)?Serial.println("Cp on GT") : Serial.println("Cp not on GT");
Serial.print("Cp comp time:");Serial.print("Cp:");FP12_output(&Cp);Serial.println();

//compute ct[]
//Serial.print("ct computation time:");
start_time=start();
for (int j=0;j<arraySize;j++){
  BIG Mivtop;
  BIG_zero(Mivtop);
  for (int k=0;k<arraySize;k++){
    if (rows[j][k] ==1){
      BIG_add(Mivtop,Mivtop,v[k]);
    }
    if (rows[j][k] ==-1){
      BIG_sub(Mivtop,Mivtop,v[k]);
    }
  }
  // calculate bHash ** Mivtop
  ECP temp1;
  ECP_copy(&temp1, &bHash);
  PAIR_G1mul(&temp1, Mivtop);
  
  // calculate attrHash[j] ** s1
  ECP temp2;
  ECP_copy(&temp2, &attr_Hash[j]);
  PAIR_G1mul(&temp2, s1);
  
  // Calculate the final ct[] = (bHash ** Mivtop) * (attrHash[j] ** s1)
  ECP_copy(&ct[j], &temp1);
  ECP_add(&ct[j], &temp2); // ct[attr] = temp1 + temp2
//  (PAIR_G1member(&ct[j])==1)? Serial.print(""): Serial.println("ct[j] not on G1");
}
stop(start_time);Serial.print(",");
Serial.print("packet assembly:");
start_time=start();
current_pos =62;
char G2char[MODBYTES_B384_29  * 2 +1];
    octet G2Octet = {0,MODBYTES_B384_29  * 2 +1,G2char};
    
    ECP2_toOctet(&G2Octet,&g_s0,true);
    memcpy(combinedCharArray+current_pos,G2Octet.val,G2Octet.len);
    current_pos += G2Octet.len;


    OCT_clear(&G2Octet);
    ECP2_toOctet(&G2Octet,&h_s1,true);
    memcpy(combinedCharArray+current_pos,G2Octet.val,G2Octet.len);
    current_pos += G2Octet.len;


    OCT_clear(&GTOctet);
    FP12_toOctet(&GTOctet,&Cp);
    Serial.print("Cp in serialized form");
    for(int q=0;q<GTOctet.len;q++){
      Serial.print(GTOctet.val[q],HEX);
    }
    Serial.println();
    memcpy(combinedCharArray+current_pos,GTOctet.val,GTOctet.len);
    current_pos += GTOctet.len;

char G1char[MODBYTES_B384_29+1];
    octet G1Octet = {0,MODBYTES_B384_29+1,G1char};
    for (int j=0;j<arraySize;j++){
      OCT_clear(&G1Octet);
      ECP_toOctet(&G1Octet,&ct[j],true);
      memcpy(combinedCharArray+current_pos,G1Octet.val,G1Octet.len);
      current_pos += G1Octet.len;

    }
    memcpy(combinedCharArray+current_pos,policy,policy_len);
      current_pos += policy_len;
    
stop(start_time);Serial.print(",");
Serial.print("schnorr:");
start_time=start(); 
schnorr.sign((const unsigned char*)combinedCharArray + 22, totalLength-86, mynonce,(unsigned char*) combinedCharArray+62+770+arraySize*49+5+policy_len,(unsigned char*)combinedCharArray+62+770+arraySize*49+5+policy_len+32, public_point);
 stop(start_time);Serial.print(",");  
 Serial.print("wifi txn:");
start_time=start(); 
  combinedCharArray[totalLength] = '\0';
//  WiFi.mode(WIFI_AP);
esp_wifi_80211_tx(WIFI_IF_AP, combinedCharArray, sizeof(combinedCharArray), false);
//WiFi.mode(WIFI_MODE_NULL);
 stop(start_time);Serial.println(""); 
 
//  for (int i = 0; i < totalLength; i++) {
//    if (combinedCharArray[i] < 16) {
//        Serial.print("0");
//    }
//    Serial.print(combinedCharArray[i], HEX);
////    Serial.print(" ");
//}
//Serial.println("");
Serial.print("total time taken:");stop(total_time);Serial.println(",");

//delay(1000);
    
  }
}
void loop() {
  // put your main code here, to run repeatedly:

}
